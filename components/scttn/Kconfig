## components/scttn/Kconfig
```kconfig
menu "The Things Network"

choice TTN_LORA_FREQ
    prompt "TTN LoRa frequency / region"
    default TTN_LORA_FREQ_DISABLED
    help
        LoRa frequency must match the geographic region the device is operated in.
        Running it with the incorrect frequency most likely violates the law.

config TTN_LORA_FREQ_DISABLED
    bool "LoRa Disabled"

config TTN_LORA_FREQ_EU_868
    bool "Europe (868 MHz)"

config TTN_LORA_FREQ_US_915
    bool "North and South America (915 MHz)"

config TTN_LORA_FREQ_AU_915
    bool "Australia (915 MHz)"

config TTN_LORA_FREQ_AS_923
    bool "Asia (923 MHz)"

config TTN_LORA_FREQ_AS_923_JP
    bool "Asia, region Japan (923 MHz)"

config TTN_LORA_FREQ_KR_920
    bool "South Korea (920 MHz)"

config TTN_LORA_FREQ_IN_866
    bool "India (866 MHz)"

endchoice

choice TTN_RADIO_CHIP
    prompt "TTN radio chip"
    default TTN_RADIO_SX1276_77_78_79
    help
        The chip type used for LoRa radio.
        Most boards use the SX1276 .. SX1279 chips. This includes ttgo LoRa and HopeRF RFM95 boards.
        Earlier boards might use the SX1272 / 73 chips, e.g. the HopeRF RFM92.

config TTN_RADIO_SX1272_73
    bool "Semtech SX1272 / SX1273"

config TTN_RADIO_SX1276_77_78_79
    bool "Semtech SX1276 / SX1277 / SX1278 / SX1279"

endchoice

config TTN_SPI_FREQ
    int "SPI frequency (in Hz)"
    default 10000000
    help
        SPI frequency to communicate between ESP32 and SX127x radio chip

config TTN_BG_TASK_PRIO
    int "Background task priority"
    default 10
    help
        Priority of task running in the background and communicating with
        the LoRaWAN radio chip. It needs a high priority as the timing is crucial.
        Higher numbers indicate higher priority.

endmenu
```
